## main/Kconfig
```kconfig
menu "Wi-Fi Configuration"
    config ESP_WIFI_SSID
        string "WiFi SSID"
        default "SPS-CORP"
        help
            SSID (network name) for the example to connect to.
	
	config ESP_WIFI_PASSWORD
        string "Wi-Fi Password"
        default "BespokeAI"
        help
            WiFi password (WPA or WPA2) for the example to use.
	
	config ESP_WIFI_CHANNEL
        int "Wi-Fi Channel"
        range 1 13
        default 1
        help
            WiFi channel (network channel) for the example to use.

    config ESP_MAX_STA_CONN
        int "Maximum STA connections"
        default 4
        help
            Max number of the STA connects to AP.
    
    config ESP_MAX_RETRY
        int "Maximum retries"
        default 5
        help
            Max number of retries given.

endmenu
```
